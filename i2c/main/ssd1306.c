#include <stdio.h>
#include "driver/spi_master.h"
#include "driver/gpio.h"
#include "driver/i2c.h"
#include "esp_log.h"
#include "freertos/FreeRTOS.h"
#include "freertos/task.h"
#include "ssd1306.h"

#define EXAMPLE_I2C_PIN_SDA         21
#define EXAMPLE_I2C_PIN_SCL         22
#define EXAMPLE_I2C_MASTER_NUM      0
#define EXAMPLE_I2C_DEV_ADDR        0x3C


const static char *TAG = "i2c";
uint8_t pixel[128 * 8] = {0}; // ssd1306 not support read operation, so use ram to save every pixel value

const uint8_t F6x8[][6] = {
    {0x00, 0x00, 0x00, 0x00, 0x00, 0x00}, // sp
    {0x00, 0x00, 0x00, 0x2f, 0x00, 0x00}, // !
    {0x00, 0x00, 0x07, 0x00, 0x07, 0x00}, // "
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    {0x14, 0x14, 0x14, 0x14, 0x14, 0x14}, // horiz lines
};

const uint8_t F8X16[] = {
    0x00, 0x00, 0x00, 0x00, 0x00, 0x00, 0x00, 0x00, 0x00, 0x00, 0x00, 0x00, 0x00, 0x00, 0x00, 0x00, // 0
    0x00, 0x00, 0x00, 0xF8, 0x00, 0x00, 0x00, 0x00, 0x00, 0x00, 0x00, 0x33, 0x30, 0x00, 0x00, 0x00, //! 1
    0x00, 0x10, 0x0C, 0x06, 0x10, 0x0C, 0x06, 0x00, 0x00, 0x00, 0x00, 0x00, 0x00, 0x00, 0x00, 0x00, //" 2
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    0x00, 0x06, 0x01, 0x01, 0x02, 0x02, 0x04, 0x04, 0x00, 0x00, 0x00, 0x00, 0x00, 0x00, 0x00, 0x00, //~ 94
};

const uint8_t Hzk[][32] = {
    {0x00,0xFE,0x22,0x5A,0x86,0x08,0x88,0x68,0x18,0x0F,0xE8,0x08,0x08,0x08,0x08,0x00},
    {0x00,0xFF,0x04,0x08,0x07,0x20,0x11,0x0D,0x41,0x81,0x7F,0x01,0x05,0x09,0x30,0x00},/*"陈",0*/

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    {0x00,0xFF,0x40,0x50,0x4C,0x43,0x40,0x40,0x4F,0x50,0x50,0x5C,0x40,0xFF,0x00,0x00},/*"园",11*/
};

static esp_err_t i2c_bus_init(void)
{
    i2c_config_t conf = {
        .mode = I2C_MODE_MASTER,
        .sda_io_num = EXAMPLE_I2C_PIN_SDA,
        .scl_io_num = EXAMPLE_I2C_PIN_SCL,
        .sda_pullup_en = GPIO_PULLUP_ENABLE,
        .scl_pullup_en = GPIO_PULLUP_ENABLE,
        .master.clk_speed = 100 * 1000,
    };

    i2c_param_config(EXAMPLE_I2C_MASTER_NUM, &conf);
    return i2c_driver_install(EXAMPLE_I2C_MASTER_NUM, conf.mode, 0, 0, 0);
}

static esp_err_t i2c_write_cmd(const uint8_t value)
{
    esp_err_t ret = ESP_OK;

    i2c_cmd_handle_t cmd = i2c_cmd_link_create();
    i2c_master_start(cmd);
    i2c_master_write_byte(cmd, (EXAMPLE_I2C_DEV_ADDR << 1) | I2C_MASTER_WRITE, true);
    i2c_master_write_byte(cmd, 0x00, true);
    i2c_master_write_byte(cmd, value, true);
    i2c_master_stop(cmd);
    ret = i2c_master_cmd_begin(EXAMPLE_I2C_MASTER_NUM, cmd, 1000 / portTICK_PERIOD_MS);
    i2c_cmd_link_delete(cmd);
    return ret;
}

static esp_err_t i2c_write_data(const uint8_t value)
{
    esp_err_t ret = ESP_OK;;

    i2c_cmd_handle_t cmd = i2c_cmd_link_create();
    i2c_master_start(cmd);
    i2c_master_write_byte(cmd, (EXAMPLE_I2C_DEV_ADDR << 1) | I2C_MASTER_WRITE, true);
    i2c_master_write_byte(cmd, 0x40, true);
    i2c_master_write_byte(cmd, value, true);
    i2c_master_stop(cmd);
    ret = i2c_master_cmd_begin(EXAMPLE_I2C_MASTER_NUM, cmd, 1000 / portTICK_PERIOD_MS);
    i2c_cmd_link_delete(cmd);
    return ret;
}

void oled_init(void)
{
    esp_err_t ret = ESP_OK;;

    ret = i2c_bus_init();
    if (ESP_OK != ret) {
        ESP_LOGE(TAG, "i2c bus init error");
    }

    i2c_write_cmd(0xAE); // display on/off, 0xAE - off, 0xAF - on
    i2c_write_cmd(0xA8); // set multiplex ratio, 0xA8 + bit[5:0]
    i2c_write_cmd(0x3F); // bit[5:0]
    i2c_write_cmd(0xD3); // set display offset, 0xD3 + bit[5:0]
    i2c_write_cmd(0x00); // bit[5:0]
    i2c_write_cmd(0x40); // set display RAM start line address, 0x40 + bit[5:0]
    i2c_write_cmd(0xA1); // set segment remap, 0xA0 + bit[0], 0xA0 - column 0 map to SEG0, 0xA1 - column 127 map to SEG0
    i2c_write_cmd(0xC8); // set Com output scan direction, 0xC0 + bit[3], 0xC0 - normal mode, 0xC8 - inverse mode
    i2c_write_cmd(0xDA); // set com pin configuartion, 0xDA + bit[5:4] + 0x02
    i2c_write_cmd(0x12); // bit[5:4] + 0x02
    i2c_write_cmd(0x81); // set contract control, 0x81 + bit[7:0]
    i2c_write_cmd(0x7F); // bit[7:0]
    i2c_write_cmd(0xA4); // set Entire Display ON, 0xA4 + bit[0], 0xA4 - resume RAM content, 0xA5 - ignore RAM content
    i2c_write_cmd(0xA6); // set normal/inverse display, 0xA6 + bit[0], 0xA6 - normal, 0xA7 - inverse
    i2c_write_cmd(0xD5); // set clk divide ratio/osc freq, 0xD5 + bit[7:0]
    i2c_write_cmd(0x80); // bit[7:0]
    i2c_write_cmd(0x8D); // set Charge Pump, 0x8D + 0x10 + bit[2]
    i2c_write_cmd(0x14); // 0x10 + bit[2]
    i2c_write_cmd(0xD9); // set Pre-Charge Period, 0xD9 + bit[7:0]
    i2c_write_cmd(0x22); // bit[7:0]
    i2c_write_cmd(0xDB); // set Vcomh deselect level, 0xDB + bit[6:4]
    i2c_write_cmd(0x20); // bit[6:4]
    i2c_write_cmd(0xAF); // display on/off, 0xAE - off, 0xAF - on
}

// x - 0~127, y - 0~7
static void oled_set_pos(uint8_t x, uint8_t y)
{
    i2c_write_cmd(0xB0 + y);                   // start page address, 0xB0 + bit[2:0]
    i2c_write_cmd(((x & 0xF0) >> 4) | 0x10);   // start column address, higher part, 0x10 + bit[3:0]
    i2c_write_cmd(x & 0x0F);                   // start column address, lower part, 0x00 + bit[3:0]
}

void oled_clear(void)
{
    uint8_t i = 0, j = 0;

    for (i = 0; i < 8; i++) {
        oled_set_pos(0, i);
        for (j = 0; j < 128; j++) {
            i2c_write_data(0x00);
            pixel[i * 128 + j] = 0x00;
        }
    }
}

void oled_show_char(uint8_t x, uint8_t y, uint8_t ch, uint8_t size)
{
    uint8_t i = 0;

    ch = ch - ' ';
    if (1 == size) {
        oled_set_pos(x, y);
        for (i = 0; i < 6; i++) {
            i2c_write_data(F6x8[ch][i]);
            pixel[y * 128 + x + i] = F6x8[ch][i];
        }
    } else {
        oled_set_pos(x, y);
        for (i = 0; i < 8; i++) {
            i2c_write_data(F8X16[ch * 16 + i]);
            pixel[y * 128 + x + i] = F8X16[ch * 16 + i];
        }
        oled_set_pos(x, y + 1);
        for (i = 0; i < 8; i++) {
            i2c_write_data(F8X16[ch * 16 + 8 + i]);
            pixel[(y + 1) * 128 + x + i] = F8X16[ch * 16 + 8 + i];
        }
    }
}

void oled_show_string(uint8_t x, uint8_t y, char *string, uint8_t size)
{
    uint8_t i = 0;

    while (string[i] != '\0') {
        oled_show_char(x, y, string[i], size);

        if (1 == size) {
            x += 6;
            if (x > 122) {
                x = 0;
                y += 1;
            }
        } else {
            x += 8;
            if (x > 120) {
                x = 0;
                y += 2;
            }
        }
        i++;
    }
}

void oled_show_chinese(uint8_t x, uint8_t y, uint8_t* index, uint8_t num)
{
    uint8_t i = 0, j = 0;

    for (j = 0; j < num; j++) {
        oled_set_pos(x, y);
        for (i = 0; i < 16; i++) {
            i2c_write_data(Hzk[2 * index[j]][i]);
            pixel[y * 128 + x + i] = Hzk[2 * index[j]][i];
        }
        oled_set_pos(x, y + 1);
        for (i = 0; i < 16; i++) {
            i2c_write_data(Hzk[2 * index[j] + 1][i]);
            pixel[(y + 1) * 128 + x + i] = Hzk[2 * index[j] + 1][i];
        }

        x += 16;
        if (x > 112) {
            x = 0;
            y += 2;
        }
    }
}

void oled_show_point(uint8_t x, uint8_t y, uint8_t value)
{
    uint8_t row = y / 8;
    uint8_t bit = y % 8;
    uint8_t mask = 0;

    if (0 == value) {
        mask = ~(1 << bit);
        pixel[row * 128 + x] &= mask;
    } else {
        mask = 1 << bit;
        pixel[row * 128 + x] |= mask;
    }

    oled_set_pos(x, row);
    i2c_write_data(pixel[row * 128 + x]);
}

void oled_show_line(uint8_t x1, uint8_t y1, uint8_t x2, uint8_t y2, uint8_t value)
{
    uint8_t x = 0, y = 0;

    if (x1 == x2) {
        for (y = y1; y <= y2; y++) {
            oled_show_point(x1, y, value);
        }
        return;
    }

    if (y1 == y2) {
        for (x = x1; x <= x2; x++) {
            oled_show_point(x, y1, value);
        }
        return;
    } 

    for (x = x1; x <= x2; x++) {
        y = y1 + ((((x - x1) * 1000) / (x2 - x1)) * (y2 - y1)) / 1000;
        oled_show_point(x, y, value);
    }
}
